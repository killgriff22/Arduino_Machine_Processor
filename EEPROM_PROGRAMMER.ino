#include <Arduino.h>
#include <EEPROM.h>

// start reading from the first byte (address 0) of the EEPROM
int address = 0;
byte program[1024] = {
  /*
  starting Byte, little endian
  Terminal height
  Terminal width
  programming flags (N/A * 7, Verbose programming )
  N/A * 5
  */
  0x0B,0x00,0x0A,100,0x02,0x00,0x00,0x00,0x00,0x00,0xFF,
  //Serial monitor, starting at 0x0A, ending 0x019
  0x0D,0x00,0x03,0x00,0x01,0x11,0x05,0x0E,0x02,0x02,0x0E,0x03,0x00,0x00,0x0B,0x0A,
  //Hello, World!, starting at 0x1A
  0x01,0x48,0x01,0x65,0x01,0x6C,0x01,0x6C,0x01,0x6F,0x01,0x0A,0x01,0x77,0x01,0x6F,
  0x01,0x72,0x01,0x6C,0x01,0x64,0x01,0x21,0x01,0x0A,0x0A,0x1B,0x00,0x00,0x00,0x00,
  0x00,0x00,0x00,0x00,0x00,0x00,0x00,0x00,0x00,0x00,0x00,0x00,0x00,0x00,0x00,0x00,
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  0x00,0x00,0x00,0x00,0xFE,
};
void setup() {
  Serial.begin(9600);
  Serial.println();
  Serial.println("Flashing...");
}

void loop() {
  // read a byte from the current address of the EEPROM
  while (Serial.available() > 0){
    byte buff[1];
    Serial.readBytes(buff, 1);
    if (buff[0] < 0x10){Serial.print("0");}
    Serial.println(buff[0], 16);

  }
  if (address == EEPROM.length()) {
    return;
  }
  if (program[4] & 0x01){
    if (address < 0x10){
      Serial.print("0");
    }
    Serial.print(address, 16);
    Serial.print("\t");
    if (program[address] < 0x10){
      Serial.print("0");
    }
    Serial.print(program[address], 16);
    Serial.print("\t");
    if (EEPROM[address] < 0x10){
      Serial.print("0");
    }
    Serial.print(EEPROM[address], 16);
    Serial.println();
  }
  EEPROM.write(address, program[address]);
  address = address + 1;
  if (address == EEPROM.length()) {
    Serial.println("Finished Flashing!");
  }
}
